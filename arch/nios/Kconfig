## arch/nios/Kconfig
```kconfig
#
# For a description of the syntax of this configuration file,
# see the file kconfig-language.txt in the NuttX tools repository.
#

if ARCH_NIOS

choice
    prompt "NIOS chip selection"
    default ARCH_CHIP_NIOS2

config ARCH_CHIP_NIOS2
    bool "NIOS2"
    select ARCH_NIOS2
    select MM_SMALL
    ---help---
        Altera NIOS2

endchoice

config ARCH_NIOS2
    bool
    default n

config ARCH_CHIP
    string
    default "nios2"     if ARCH_CHIP_NIOS2

source arch/nios/src/common/Kconfig
source arch/nios/src/nios2/Kconfig

endif # ARCH_NIOS
```

## arch/nios/src/nios2/Kconfig
```kconfig
#
# For a description of the syntax of this configuration file,
# see the file kconfig-language.txt in the NuttX tools repository.
#

if ARCH_NIOS2
comment "NIOS2 Configuration Options"

choice
	prompt "Toolchain Selection"
	default NIOS2_TOOLCHAIN_GNU_ELFW if TOOLCHAIN_WINDOWS
	default NIOS2_TOOLCHAIN_GNU_ELFL if !TOOLCHAIN_WINDOWS

config NIOS2_TOOLCHAIN_CODESOURCERYL
	bool "CodeSourcery GNU toolchain under Linux"
	depends on HOST_LINUX
	---help---
		For use with the GNU toolchain built with the NuttX buildroot package.
		This tools may be nios2-nuttx-elf-.

config NIOS2_TOOLCHAIN_CODESOURCERYW
	bool "CodeSourcery GNU toolchain under Windows"
	depends on TOOLCHAIN_WINDOWS

config NIOS2_TOOLCHAIN_GNU_ELFL
	bool "Generic GNU ELF toolchain under Linux (or other POSIX environment)"
	---help---
		This option should work for any modern GNU toolchain (GCC 4.5 or newer)
		configured for nios2-elf-.

config NIOS2_TOOLCHAIN_GNU_ELFW
	bool "Generic GNU ELF toolchain under Windows"
	depends on TOOLCHAIN_WINDOWS
	---help---
		This option should work for any modern GNU toolchain (GCC 4.5 or newer)
		configured for nios2-elf-.

endchoice

endif
```
